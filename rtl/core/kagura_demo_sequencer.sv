// SPDX-License-Identifier: Apache-2.0
// Hardware test stand-in for the CPU: drives the CPU-independent request
// interface after reset, like a driver would through the register window.
// 1. INC=1; palette shadow: palette p, colour i -> R=i, G=p, B=15-i
//    (colour 0 of every palette is black so tile edges stay visible).
// 2. Patterns: 16 tiles; tile t pixel (x,y) = 15 on the top row and the
//    left column (an orientation mark), else ((x+y+t) mod 15)+1.
// 3. Map 64x32: tile (col+row) mod 16, palette row mod 16, H flip on odd
//    columns of rows 8..15, V flip on odd columns of rows 16..23.
//    SPRITES=1 also initializes all OAM, with eight 16px sprites exercising
//    base-tile alignment, flips and behind; the last 56 records are disabled.
// 4. BACKDROP=0, RASTER off, DISPLAY_CTRL=display+BG, COMMIT, wait for it.
// 4b. Read back six bytes (map in both halves, pattern, palette) through
//    READ_REQUEST/READ_RESULT and flag mismatches (hardware diagnosis).
// 5. Forever: scroll X += 1 (mod 512), Y += 1 every 4 frames, COMMIT, wait
//    until COMMIT_BUSY clears (one update per frame).
// AUDIO=1 first loads triangle (ch4) and sine (ch5) waves into the wave
// shadow, enables all six voices silently and AUDIO_COMMITs, then loads the
// waves again so both banks match (every later commit swaps them). Each
// frame then advances a small song player before the scroll update: it
// writes the steps and envelope gains of all voices and AUDIO_COMMITs.
// SCENE=1 replaces the test content (steps 1..3, OAM included) with a
// vertical shooter scene, skips the read-back checks, and each update also
// rewrites the moving sprites and twinkling colours (see the scene block).
// Its enemies flap with the song rows, so it is meant for AUDIO=1.
// Accesses are spaced like a 3.375MHz CPU; a refused write is retried.
// Generated bytes come from registers up to four cycles behind count, so
// SPACING must stay at 5 or more.
module kagura_demo_sequencer #(
    parameter integer SPACING=16,
    parameter bit SPRITES=0,
    parameter bit AUDIO=0,
    parameter bit SCENE=0,
    parameter bit RASTER=0,          // write a raster scroll table before the first COMMIT (CAPS RSCROLL, LINES>=161)
    parameter [15:0] ANIM_START=0,   // SCENE: first anim value (tests start inside a wall phase)
    parameter integer LINES=240      // SCENE: logical screen height (180 for 16:9)
) (
    input wire clk, reset,
    output reg req_valid,
    input wire req_ready,
    output reg req_write,
    output reg [4:0] req_addr,
    // Kept as fabric flops: absorbed into the art BSRAM output register, the
    // slow DO would feed the register window opcode decode directly.
    (* syn_preserve=1 *) output reg [7:0] req_wdata,
    input wire rsp_valid,
    input wire [7:0] rsp_rdata,
    input wire rsp_error,
    output reg configured,           // first COMMIT done
    output reg [15:0] frames,        // animation updates committed
    output reg [31:0] map_readback,
    output reg [31:0] map_written,
    output reg map_bad, data_bad,    // read-back mismatch: map / pattern or palette
    output reg sprite_overflow       // SCENE: the last checked frame dropped sprites (SPR_OVERFLOW)
);
    localparam [4:0] STATUS=5'h00, IRQ_STATUS=5'h01, DISPLAY_CTRL=5'h03, ADDR_L=5'h04, ADDR_M=5'h05, ADDR_H=5'h06,
        VRAM_WRITE=5'h07, READ_REQUEST=5'h08, READ_RESULT=5'h09, EXT_INDEX=5'h0a, EXT_DATA=5'h0b,
        AUDIO_INDEX=5'h0c,AUDIO_DATA=5'h0d,COMMAND=5'h0e, INC_L=5'h10, INC_H=5'h11, ERROR_CODE=5'h17;
    // Program steps.
    localparam [4:0] S_INC_L=0, S_INC_H=1, S_PAL_ADDR=2, S_PAL=3, S_PAT_ADDR=4, S_PAT=5,
        S_MAP_ADDR=6, S_MAP=7, S_EXT=8, S_DISPLAY=9, S_COMMIT=10, S_WAIT=11, S_ERR_READ=12,
        S_ERR_CLEAR=13, S_SCROLL=14, S_IDLE=15, S_CHECK=16, S_OAM_ADDR=17, S_OAM=18, S_INIT=19,
        S_WAVE_ADDR=20,S_WAVE=21,S_AUDIO_CFG=22,S_AUDIO_COMMIT=23,S_AUDIO_WAIT=24,
        S_MUSIC=25,S_MUSIC_WRITE=26,S_SCENE_ADDR=27,S_SCENE_OAM=28,S_SCENE_PAL=29,
        S_OVF_READ=30,S_OVF_CLEAR=31;
    reg [4:0] step;
    // {EXT index, value}: RS_COUNT=3, RS_INDEX=0, then LINE/X_L/X_H/Y per entry.
    function automatic [15:0] rs_pair(input [4:0] j);
        case(j)
            5'd0: rs_pair={8'h0b,8'd3};
            5'd1: rs_pair={8'h0c,8'd0};
            5'd2: rs_pair={8'h0d,8'd100};
            5'd6: rs_pair={8'h0d,8'd130};
            5'd7: rs_pair={8'h0e,8'd40};
            5'd10: rs_pair={8'h0d,8'd160};
            5'd3,5'd11: rs_pair={8'h0e,8'd0};
            5'd4,5'd8,5'd12: rs_pair={8'h0f,8'd0};
            default: rs_pair={8'h10,8'd0};
        endcase
    endfunction
    reg [12:0] count;                  // byte index within a stream / sub-step
    reg [8:0] scroll_x;
    reg [7:0] scroll_y;
    reg [1:0] frame_div;

    // Initial voice setup: all six voices enabled with phase reset, STEP and
    // gains 0 (silent until the song player writes them). Pulse duty ch0 1/4,
    // ch1 1/8, ch2 1/4; wave length 256; MASTER 48.
    function automatic [15:0] audio_entry(input [6:0] n);
        reg [3:0] ch,off;
        begin
            ch=4'(n/10); off=4'(n%10);
            case(off)
                4'd3: audio_entry={ch,off,ch==1 ? 8'h20 : ch<3 ? 8'h40 : 8'h00};
                4'd6: audio_entry={ch,off,8'h03};
                4'd7: audio_entry={ch,off,ch>=4 ? 8'h08 : 8'h00};
                default: audio_entry={ch,off,8'h00};
            endcase
            if(n>=60) audio_entry=16'he030;
        end
    endfunction
    reg [15:0] audio_now;
    always @(posedge clk) audio_now<=audio_entry(count[7:1]);
    // Wave shadow bytes: ch4 (count[8]=0) triangle, ch5 a sine made of one
    // parabola per half period, h*(127-h)/32 peaking at 126.
    wire [6:0] wave_h=count[6:0];
    wire [7:0] wave_arch=8'((14'(wave_h)*14'(7'd127-wave_h))>>5);
    reg [7:0] wave_byte;
    always @(posedge clk)
        if(!count[8]) wave_byte<=count[7] ? 8'd127-{wave_h,1'b0} : {wave_h,1'b0}-8'd128;
        else wave_byte<=count[7] ? 8'd0-wave_arch : wave_arch;
    reg waves_twice;                   // second wave load (other bank) done

    // Song player: one call per frame, 128 rows of TEMPO frames (about 15s),
    // the first 64 rows without lead/echo on the first pass. A minor,
    // chords per 16-row bar Am F C G | Dm Em F G.
    // ch0 lead (vibrato after 12 frames), ch1 chord arpeggio (one tone per
    // frame), ch2 the lead three rows late, ch3 hi-hat/snare, ch4 octave
    // bass, ch5 kick (sine falling from 160Hz). Gains are software envelopes.
    // Notes are {octave, semitone}; lead codes 0 hold, 1 release.
    localparam integer TEMPO=7;
    localparam [6:0] HOLD=7'h00, REST=7'h01;
    function automatic [6:0] lead_code(input [6:0] row);
        case(row)
            7'd0: lead_code={3'd4,4'd9};   7'd3: lead_code={3'd5,4'd0};   7'd6: lead_code={3'd5,4'd4};
            7'd8: lead_code={3'd5,4'd9};   7'd12: lead_code={3'd5,4'd7};  7'd14: lead_code={3'd5,4'd4};
            7'd16: lead_code={3'd5,4'd5};  7'd20: lead_code={3'd5,4'd4};  7'd22: lead_code={3'd5,4'd0};
            7'd24: lead_code={3'd4,4'd9};  7'd28: lead_code={3'd5,4'd0};  7'd30: lead_code=REST;
            7'd32: lead_code={3'd4,4'd7};  7'd35: lead_code={3'd5,4'd0};  7'd38: lead_code={3'd5,4'd4};
            7'd40: lead_code={3'd5,4'd7};  7'd44: lead_code={3'd5,4'd9};  7'd46: lead_code={3'd5,4'd7};
            7'd48: lead_code={3'd5,4'd2};  7'd54: lead_code={3'd4,4'd11}; 7'd56: lead_code={3'd4,4'd7};
            7'd60: lead_code=REST;
            7'd64: lead_code={3'd5,4'd2};  7'd67: lead_code={3'd5,4'd5};  7'd70: lead_code={3'd5,4'd9};
            7'd74: lead_code={3'd5,4'd7};  7'd76: lead_code={3'd5,4'd5};  7'd78: lead_code={3'd5,4'd4};
            7'd80: lead_code={3'd5,4'd4};  7'd83: lead_code={3'd5,4'd7};  7'd86: lead_code={3'd5,4'd11};
            7'd90: lead_code={3'd5,4'd9};  7'd92: lead_code={3'd5,4'd7};  7'd94: lead_code={3'd5,4'd4};
            7'd96: lead_code={3'd5,4'd5};  7'd98: lead_code={3'd5,4'd9};  7'd100: lead_code={3'd6,4'd0};
            7'd104: lead_code={3'd5,4'd11};7'd106: lead_code={3'd5,4'd9}; 7'd108: lead_code={3'd5,4'd7};
            7'd110: lead_code={3'd5,4'd5}; 7'd112: lead_code={3'd5,4'd7}; 7'd116: lead_code={3'd5,4'd5};
            7'd120: lead_code={3'd5,4'd4}; 7'd122: lead_code={3'd5,4'd2}; 7'd124: lead_code={3'd4,4'd11};
            default: lead_code=HOLD;
        endcase
    endfunction
    function automatic [4:0] chord(input [2:0] bar);   // {minor, root semitone}
        case(bar)
            3'd0: chord={1'b1,4'd9}; 3'd1: chord={1'b0,4'd5}; 3'd2: chord={1'b0,4'd0}; 3'd3: chord={1'b0,4'd7};
            3'd4: chord={1'b1,4'd2}; 3'd5: chord={1'b1,4'd4}; 3'd6: chord={1'b0,4'd5}; default: chord={1'b0,4'd7};
        endcase
    endfunction
    function automatic [6:0] add_semi(input [6:0] note,input [3:0] up);
        reg [4:0] s;
        begin
            s=5'(note[3:0])+5'(up);
            add_semi=s>=12 ? {note[6:4]+3'd1,4'(s-5'd12)} : {note[6:4],s[3:0]};
        end
    endfunction
    // STEP of octave 7 (C7..B7), round(f*2^24/48000); lower octaves shift.
    function automatic [20:0] step7(input [3:0] s);
        case(s)
            4'd0: step7=21'd731558;  4'd1: step7=21'd775059;  4'd2: step7=21'd821146;
            4'd3: step7=21'd869974;  4'd4: step7=21'd921705;  4'd5: step7=21'd976513;
            4'd6: step7=21'd1034579; 4'd7: step7=21'd1096099; 4'd8: step7=21'd1161276;
            4'd9: step7=21'd1230329; 4'd10: step7=21'd1303488; default: step7=21'd1380998;
        endcase
    endfunction
    function automatic [7:0] decay(input [7:0] v,input [1:0] shift);
        reg [7:0] d;
        begin d=v>>shift; decay=v-(d==0 && v!=0 ? 8'd1 : d); end
    endfunction
    reg music_tick;                    // the program's per-frame call
    reg [2:0] tick;
    reg [6:0] row;
    reg looped;
    reg [6:0] lead_note,echo_note,bass_note,hist0,hist1,hist2;
    reg lead_gate,echo_gate,snare;
    reg [7:0] lead_level,arp_level,echo_level,noise_level,bass_level,kick_level;
    reg [15:0] kick_step;
    reg [1:0] arp_index;
    reg [4:0] vib_age;
    reg [2:0] lfo;
    wire [3:0] beat=row[3:0];
    wire [4:0] chord_now=chord(row[6:4]);
    wire [6:0] code=looped || row[6] ? lead_code(row) : HOLD;
    wire kick_hit=beat==0 || beat==8 || (row[4] && beat==10);
    wire snare_hit=beat==4 || beat==12 || (row[6:4]==3'd7 && beat>=13);
    wire [6:0] bass_root={chord_now[3:0]<5 ? 3'd3 : 3'd2,chord_now[3:0]};
    wire [6:0] bass_base=beat[3:2]==2'd3 ? add_semi(bass_root,4'd7) : bass_root;
    wire [6:0] arp_note=add_semi({3'd4,chord_now[3:0]},
        arp_index==0 ? 4'd0 : arp_index==1 ? (chord_now[4] ? 4'd3 : 4'd4) : 4'd7);
    always @(posedge clk)
        if(reset) begin
            tick<=0; row<=0; looped<=0; lead_note<=0; echo_note<=0; bass_note<=0;
            hist0<=HOLD; hist1<=HOLD; hist2<=HOLD; lead_gate<=0; echo_gate<=0; snare<=0;
            lead_level<=0; arp_level<=0; echo_level<=0; noise_level<=0; bass_level<=0; kick_level<=0;
            kick_step<=0; arp_index<=0; vib_age<=0; lfo<=0;
        end else if(music_tick) begin
            // Envelopes and sweeps; row events below override them.
            lead_level<=lead_gate ? (lead_level>8'd112 ? lead_level-8'd2 : lead_level) : decay(lead_level,2'd2);
            echo_level<=echo_gate ? (echo_level>8'd56 ? echo_level-8'd1 : echo_level) : decay(echo_level,2'd2);
            arp_level<=decay(arp_level,2'd3);
            noise_level<=decay(noise_level,snare ? 2'd2 : 2'd1);
            bass_level<=bass_level>8'd150 ? bass_level-8'd8 : bass_level;
            kick_level<=decay(kick_level,2'd2);
            if(kick_step>16'd15729) kick_step<=kick_step-(kick_step>>3);
            if(vib_age!=5'd31) vib_age<=vib_age+1'b1;
            lfo<=lfo+1'b1;
            arp_index<=arp_index==2'd2 ? 2'd0 : arp_index+1'b1;
            tick<=tick==3'(TEMPO-1) ? 3'd0 : tick+1'b1;
            if(tick==3'(TEMPO-1)) begin row<=row+1'b1; if(row==7'd127) looped<=1; end
            if(tick==0) begin
                if(code>REST) begin lead_note<=code; lead_gate<=1; lead_level<=8'd160; vib_age<=0; end
                else if(code==REST) lead_gate<=0;
                hist0<=code; hist1<=hist0; hist2<=hist1;
                if(hist2>REST) begin echo_note<=hist2; echo_gate<=1; echo_level<=8'd80; end
                else if(hist2==REST) echo_gate<=0;
                arp_level<=8'd72;
                if(kick_hit) begin kick_level<=8'd255; kick_step<=16'd55924; end
                if(snare_hit) begin snare<=1; noise_level<=8'd200; end
                else if(!beat[0]) begin snare<=0; noise_level<=beat[1] ? 8'd80 : 8'd40; end
                if(!beat[0]) begin
                    bass_note<={bass_base[6:4]+{2'd0,beat[1]},bass_base[3:0]};
                    bass_level<=8'd230;
                end
            end
        end
    // Per-frame register list, entry count[5:1] (index, then data): STEP
    // bytes and L/R gains of each voice, the noise period. ch1 sits left,
    // ch2 right, ch3 slightly right. Bytes pass four register stages.
    function automatic [7:0] entry_index(input [4:0] e);
        case(e)
            5'd0: entry_index=8'h00;  5'd1: entry_index=8'h01;  5'd2: entry_index=8'h02;
            5'd3: entry_index=8'h04;  5'd4: entry_index=8'h05;  5'd5: entry_index=8'h10;
            5'd6: entry_index=8'h11;  5'd7: entry_index=8'h12;  5'd8: entry_index=8'h14;
            5'd9: entry_index=8'h15;  5'd10: entry_index=8'h20; 5'd11: entry_index=8'h21;
            5'd12: entry_index=8'h22; 5'd13: entry_index=8'h24; 5'd14: entry_index=8'h25;
            5'd15: entry_index=8'h38; 5'd16: entry_index=8'h34; 5'd17: entry_index=8'h35;
            5'd18: entry_index=8'h40; 5'd19: entry_index=8'h41; 5'd20: entry_index=8'h42;
            5'd21: entry_index=8'h44; 5'd22: entry_index=8'h45; 5'd23: entry_index=8'h50;
            5'd24: entry_index=8'h51; 5'd25: entry_index=8'h52; 5'd26: entry_index=8'h54;
            default: entry_index=8'h55;
        endcase
    endfunction
    reg [4:0] entry_a,entry_b,entry_c;
    reg [6:0] note_a;
    reg [20:0] step_b;
    reg [23:0] step_c;
    reg [15:0] music_now;
    always @(posedge clk) begin
        entry_a<=count[5:1];
        case(count[5:1])
            5'd0,5'd1,5'd2: note_a<=lead_note;
            5'd5,5'd6,5'd7: note_a<=arp_note;
            5'd10,5'd11,5'd12: note_a<=echo_note;
            default: note_a<=bass_note;
        endcase
        entry_b<=entry_a;
        step_b<=step7(note_a[3:0])>>(3'd7-note_a[6:4]);
        entry_c<=entry_b;
        if(entry_b>=5'd23) step_c<={8'd0,kick_step};
        else if(entry_b<5'd3 && vib_age>=5'd12) case(lfo)
            3'd1,3'd3: step_c<=24'(step_b)+24'(step_b>>8);
            3'd2: step_c<=24'(step_b)+24'(step_b>>7);
            3'd5,3'd7: step_c<=24'(step_b)-24'(step_b>>8);
            3'd6: step_c<=24'(step_b)-24'(step_b>>7);
            default: step_c<=24'(step_b);
        endcase
        else step_c<=24'(step_b);
        music_now[15:8]<=entry_index(entry_c);
        case(entry_c)
            5'd0,5'd5,5'd10,5'd18,5'd23: music_now[7:0]<=step_c[7:0];
            5'd1,5'd6,5'd11,5'd19,5'd24: music_now[7:0]<=step_c[15:8];
            5'd2,5'd7,5'd12,5'd20,5'd25: music_now[7:0]<=step_c[23:16];
            5'd3,5'd4: music_now[7:0]<=lead_level;
            5'd8: music_now[7:0]<=arp_level;
            5'd9: music_now[7:0]<=arp_level>>1;
            5'd13: music_now[7:0]<=echo_level>>1;
            5'd14: music_now[7:0]<=echo_level;
            5'd15: music_now[7:0]<=snare ? 8'd2 : 8'd0;
            5'd16: music_now[7:0]<=noise_level-(noise_level>>2);
            5'd17: music_now[7:0]<=noise_level;
            5'd21,5'd22: music_now[7:0]<=bass_level;
            default: music_now[7:0]<=kick_level;
        endcase
    end

    // Read-back checks: {address, expected}; entries 0..3 are map bytes.
    function automatic [23:0] check_entry(input [2:0] n);
        case(n)
            3'd0: check_entry={16'h8082,8'h02};  // map word 65: tile 2, palette 1
            3'd1: check_entry={16'h8083,8'h04};
            3'd2: check_entry={16'h880a,8'h05};  // map word 1029 (second RAM): V flip, tile 5
            3'd3: check_entry={16'h880b,8'h80};
            3'd4: check_entry={16'h0024,8'hf4};  // tile 1 row 1 byte 0
            default: check_entry={16'h943e,8'h10}; // palette 1 colour 15 = 0xF10, low byte
        endcase
    endfunction
    wire [23:0] check_now=check_entry(count[5:3]);
    // Generated data for the current stream byte.
    wire [7:0] pal_word=count[8:1];    // palette p=word[7:4], colour i=word[3:0]
    wire [3:0] pal_p=pal_word[7:4], pal_i=pal_word[3:0];
    wire [11:0] pal_rgb=pal_i==0 ? 12'h000 : {pal_i,pal_p,4'd15-pal_i};
    wire [7:0] pal_byte=count[0] ? {4'h0,pal_rgb[11:8]} : pal_rgb[7:0];
    function automatic [3:0] tile_pixel(input [3:0] t,input [2:0] x,input [2:0] y);
        integer v;
        begin
            if(x==0 || y==0) tile_pixel=4'd15;
            else begin v=(x+y+t)%15; tile_pixel=4'(v+1); end
        end
    endfunction
    wire [3:0] pat_t=count[8:5];
    wire [2:0] pat_y=count[4:2];
    wire [2:0] pat_x=3'({count[1:0],1'b0});
    wire [7:0] pat_byte={tile_pixel(pat_t,pat_x,pat_y),tile_pixel(pat_t,pat_x+3'd1,pat_y)};
    wire [10:0] map_word=count[11:1];  // row=word[10:6], col=word[5:0]
    wire [4:0] map_row=map_word[10:6];
    wire [5:0] map_col=map_word[5:0];
    wire map_h=map_col[0] && map_row[4:3]==2'd1;
    wire map_v=map_col[0] && map_row[4:3]==2'd2;
    wire [15:0] map_entry={map_v,map_h,map_row[3:0],6'd0,4'(map_col+map_row)};
    wire [7:0] map_byte=count[0] ? map_entry[15:8] : map_entry[7:0];
    wire [5:0] oam_n=count[8:3];
    reg [7:0] oam_byte;
    always @* begin
        oam_byte=0;
        if(oam_n<8) case(count[2:0])
            3'd0: oam_byte=8'd32+8'(oam_n*24);
            3'd2: oam_byte=8'd40+{oam_n[1:0],5'b0};
            3'd4: oam_byte={4'b0,oam_n[1:0],2'b11};
            3'd5: oam_byte={2'b0,4'(15-oam_n),2'b0};
            3'd6: oam_byte={3'b0,oam_n[2:0],2'b11};
            default: ;
        endcase
    end

    // SCENE=1 content: a vertical shooter. Tiles come from kagura_demo_art
    // (tools/gen-demo-art.py). The map is a hashed starfield (tiles 1..5,
    // random flips) with a 4x4-tile planet at rows 6..9, columns 26..29;
    // scroll Y = -anim moves it down one pixel per update. Sprites, as
    // functions of anim (updates committed) and the song row:
    //   0 ship (y=LINES-44: 196, or 136 on the 180-line screen), 1 engine
    //   flame, 2..5 shots (one launched every 8 updates, hidden after 24
    //   updates, 120 lines above the ship), 6..9 enemy shots from the lower enemy row,
    //   10..25 enemy formation 2x8 (flaps every two song rows),
    //   26..29 fast streak stars, 30..41 title "KAGURA-9 DEMO" at y=12,
    //   42..63 a 22-wide enemy wall that crosses the 16 sprites/line limit.
    // anim[9:8] selects the wall phase (256 updates each): 0 and 3 hidden,
    // 1 descending in fixed OAM order (the highest slots drop out on its
    // lines), 2 the same with the members rotated by 8 slots per update
    // (software flicker: every member is dropped one update in three).
    // Each update rewrites all OAM, palette 0 colours 6/7 (twinkle) and
    // palette 6 colour 1 (rainbow title) before COMMIT.
    reg [15:0] anim;
    reg [4:0] rotate;                  // 8*anim mod 22
    wire [31:0] art_word;
    generate if(SCENE) begin: scene_art
        kagura_demo_art art(.clk(clk),.addr(count[10:2]),.data(art_word));
    end else begin: no_scene_art
        assign art_word=0;
    end endgenerate
    reg [7:0] scene_pat_byte;
    always @*
        case(count[1:0])
            2'd0: scene_pat_byte=art_word[31:24];
            2'd1: scene_pat_byte=art_word[23:16];
            2'd2: scene_pat_byte=art_word[15:8];
            default: scene_pat_byte=art_word[7:0];
        endcase
    function automatic [3:0] twinkle(input [2:0] p);
        case(p)
            3'd0: twinkle=4'd3; 3'd1: twinkle=4'd6; 3'd2: twinkle=4'd9; 3'd3: twinkle=4'd12;
            3'd4: twinkle=4'd15; 3'd5: twinkle=4'd12; 3'd6: twinkle=4'd9; default: twinkle=4'd6;
        endcase
    endfunction
    function automatic [11:0] rainbow(input [3:0] h);
        case(h)
            4'd0: rainbow=12'hf00; 4'd1: rainbow=12'hf60; 4'd2: rainbow=12'hfb0; 4'd3: rainbow=12'hff0;
            4'd4: rainbow=12'h9f0; 4'd5: rainbow=12'h3f3; 4'd6: rainbow=12'h0f8; 4'd7: rainbow=12'h0ff;
            4'd8: rainbow=12'h0af; 4'd9: rainbow=12'h05f; 4'd10: rainbow=12'h33f; 4'd11: rainbow=12'h80f;
            4'd12: rainbow=12'hd0f; 4'd13: rainbow=12'hf0c; 4'd14: rainbow=12'hf07; default: rainbow=12'hf03;
        endcase
    endfunction
    // Palette word {palette, colour} -> RGB444.
    function automatic [11:0] scene_colour(input [7:0] w,input [15:0] k);
        reg [3:0] v6,v7;
        begin
            v6=twinkle(k[4:2]); v7=twinkle(k[4:2]+3'd4);
            case(w)
                8'h00: scene_colour=12'h002; 8'h03: scene_colour=12'h445; 8'h04: scene_colour=12'h889;
                8'h05: scene_colour=12'hfff; 8'h06: scene_colour={v6,v6,4'hf}; 8'h07: scene_colour={v7,v7,v7};
                8'h08: scene_colour=12'h213; 8'h09: scene_colour=12'h425; 8'h0a: scene_colour=12'h637;
                8'h0b: scene_colour=12'h96a; 8'h0c: scene_colour=12'hcad;
                8'h11: scene_colour=12'heef; 8'h12: scene_colour=12'haab; 8'h13: scene_colour=12'h557;  // ship
                8'h14: scene_colour=12'h4af; 8'h15: scene_colour=12'he33; 8'h16: scene_colour=12'hf90;
                8'h17: scene_colour=12'hff4;
                8'h21: scene_colour=12'h7f5; 8'h22: scene_colour=12'h3a3; 8'h23: scene_colour=12'h152;  // enemy A
                8'h24: scene_colour=12'hf22; 8'h25: scene_colour=12'hfff;
                8'h31: scene_colour=12'hf6c; 8'h32: scene_colour=12'ha38; 8'h33: scene_colour=12'h515;  // enemy B
                8'h34: scene_colour=12'hff0; 8'h35: scene_colour=12'hfff;
                8'h41: scene_colour=12'hfff; 8'h42: scene_colour=12'h8ff; 8'h43: scene_colour=12'h4af;  // shots
                8'h44: scene_colour=12'hf84; 8'h45: scene_colour=12'hff8;
                8'h51: scene_colour=12'hfc4; 8'h52: scene_colour=12'hc72; 8'h53: scene_colour=12'h630;  // wall
                8'h54: scene_colour=12'hf22; 8'h55: scene_colour=12'hfff;
                8'h61: scene_colour=rainbow(k[5:2]); 8'h62: scene_colour=12'h225;                   // title
                default: scene_colour=12'h000;
            endcase
        end
    endfunction
    // The per-update palette stream: count 4..7 words 06/07, 12..13 word 61.
    reg [11:0] scene_rgb;
    always @(posedge clk)
        scene_rgb<=scene_colour(step!=S_SCENE_PAL ? count[8:1] : count[3] ? 8'h61 : {7'd3,count[1]},anim);
    wire [7:0] scene_pal_byte=count[0] ? {4'h0,scene_rgb[11:8]} : scene_rgb[7:0];
    function automatic [9:0] star_tile(input [7:0] h);
        star_tile=h<200 ? 10'd0 : h<220 ? 10'd1 : h<235 ? 10'd2 : h<242 ? 10'd4 : h<248 ? 10'd5 : 10'd3;
    endfunction
    wire [10:0] scene_map_word=count[11:1];  // row=word[10:6], col=word[5:0]
    wire [4:0] scene_map_row=scene_map_word[10:6];
    wire [5:0] scene_map_col=scene_map_word[5:0];
    wire [15:0] star_hash=16'(scene_map_word*16'd40503);
    reg [15:0] scene_map_entry;
    always @(posedge clk)
        if(scene_map_row>=6 && scene_map_row<10 && scene_map_col>=26 && scene_map_col<30)
            scene_map_entry<={6'd0,6'd2,2'(scene_map_row-5'd6),2'(scene_map_col-6'd26)};  // tile 32+4r+c
        else scene_map_entry<={star_hash[7:6],4'd0,star_tile(star_hash[15:8])};
    wire [7:0] scene_map_byte=count[0] ? scene_map_entry[15:8] : scene_map_entry[7:0];

    // Sprite record generator: sprite count[8:3], byte count[2:0]; four
    // register stages (kind and sine arguments, sines, position, byte).
    function automatic signed [7:0] sine(input [7:0] i);  // one parabola per half
        reg [13:0] p;
        begin
            p=14'(i[6:0])*14'(7'd127-i[6:0]);
            sine=i[7] ? 8'sd0-$signed({1'b0,p[11:5]}) : $signed({1'b0,p[11:5]});
        end
    endfunction
    function automatic [9:0] title_tile(input [3:0] t);  // K A G U R A - 9 D E M O
        case(t)
            4'd0: title_tile=10'd48; 4'd1: title_tile=10'd49; 4'd2: title_tile=10'd50; 4'd3: title_tile=10'd51;
            4'd4: title_tile=10'd52; 4'd5: title_tile=10'd49; 4'd6: title_tile=10'd53; 4'd7: title_tile=10'd54;
            4'd8: title_tile=10'd55; 4'd9: title_tile=10'd56; 4'd10: title_tile=10'd57; default: title_tile=10'd58;
        endcase
    endfunction
    localparam [3:0] K_OFF=0, K_SHIP=1, K_FLAME=2, K_SHOT=3, K_ESHOT=4, K_ENEMY=5, K_STAR=6,
        K_TITLE=7, K_WALL=8;
    wire [5:0] sprite_n=count[8:3];
    wire [1:0] shot_slot=2'(sprite_n-6'd2);
    wire [1:0] eshot_slot=2'(sprite_n-6'd6);
    wire [3:0] enemy_slot=4'(sprite_n-6'd10);
    wire [4:0] wall_slot=5'(sprite_n-6'd42);
    wire [5:0] wall_turned={1'b0,wall_slot}+{1'b0,rotate};
    wire wall_flicker=anim[9:8]==2'd2;
    wire wall_on=anim[9:8]==2'd1 || wall_flicker;
    wire [4:0] shot_age=5'(anim)+{shot_slot,3'd0};
    wire [15:0] eshot_time=anim+{9'd0,eshot_slot,5'd0};  // age bits 6:0, cycle bits 15:7
    wire [2:0] eshot_col=3'(eshot_time[9:7]*3)+{eshot_slot,1'b0};
    wire [15:0] shot_launch=anim-{11'd0,shot_age};
    wire [15:0] eshot_launch=anim-{9'd0,eshot_time[6:0]};
    reg [3:0] kind_a,kind_b;
    reg [2:0] byte_a,byte_b,byte_c,col_a,col_b;
    reg [4:0] slot_a,slot_b;          // star, title letter or wall member
    reg [6:0] age_a,age_b;
    reg row_a,row_b;
    reg [7:0] arg1_a,arg2_a;
    reg signed [7:0] sine1_b,sine2_b;
    reg [9:0] x_c,y_c,tile_c;
    reg [3:0] pal_c;
    reg big_c,enable_c;
    reg [7:0] scene_oam_byte;
    wire signed [10:0] sine1=sine1_b, sine2=sine2_b;
    wire signed [10:0] ship_dx=((sine1<<<2)+sine1)>>>3;   // +-78
    wire signed [10:0] enemy_dx=((sine1<<<1)+sine1)>>>3;  // +-47
    wire signed [10:0] bob=sine2>>>5, ripple=sine2>>>4;
    // The ship sits 44 lines above the bottom so it stays on a 180-line screen.
    localparam signed [10:0] SHIP_Y=11'(LINES-44);
    always @(posedge clk) begin
        byte_a<=count[2:0];
        kind_a<=K_OFF; slot_a<=0; age_a<=0; col_a<=0; row_a<=0; arg1_a<=0; arg2_a<=0;
        if(sprite_n<2) begin
            kind_a<=sprite_n==0 ? K_SHIP : K_FLAME; arg1_a<=8'(anim*3); arg2_a<={anim[4:0],3'd0};
        end else if(sprite_n<6) begin
            kind_a<=K_SHOT; age_a<={2'd0,shot_age}; arg1_a<=8'(shot_launch*3);
        end else if(sprite_n<10) begin
            kind_a<=K_ESHOT; age_a<=eshot_time[6:0]; col_a<=eshot_col;
            arg1_a<=eshot_launch[7:0]; arg2_a<={eshot_launch[5:0],2'd0}+{eshot_col,5'd0};
        end else if(sprite_n<26) begin
            kind_a<=K_ENEMY; col_a<=enemy_slot[2:0]; row_a<=enemy_slot[3];
            arg1_a<=anim[7:0]; arg2_a<={anim[5:0],2'd0}+{enemy_slot[2:0],5'd0};
        end else if(sprite_n<30) begin kind_a<=K_STAR; slot_a<=5'(sprite_n-6'd26); end
        else if(sprite_n<42) begin kind_a<=K_TITLE; slot_a<=5'(sprite_n-6'd30); end
        else begin
            kind_a<=K_WALL;
            slot_a<=!wall_flicker ? wall_slot : wall_turned>=22 ? 5'(wall_turned-6'd22) : wall_turned[4:0];
        end

        kind_b<=kind_a; byte_b<=byte_a; slot_b<=slot_a; age_b<=age_a; col_b<=col_a; row_b<=row_a;
        sine1_b<=sine(arg1_a); sine2_b<=sine(arg2_a);

        byte_c<=byte_b; x_c<=0; y_c<=0; tile_c<=0; pal_c<=0; big_c<=0; enable_c<=0;
        case(kind_b)
            K_SHIP: begin x_c<=10'(11'sd152+ship_dx); y_c<=10'(SHIP_Y+bob); tile_c<=10'd12; pal_c<=4'd1; big_c<=1; enable_c<=1; end
            K_FLAME: begin x_c<=10'(11'sd156+ship_dx); y_c<=10'(SHIP_Y+11'sd15+bob); tile_c<=10'd9+{9'd0,anim[1]}; pal_c<=4'd1; enable_c<=1; end
            K_SHOT: begin
                x_c<=10'(11'sd156+ship_dx); y_c<=10'(SHIP_Y-11'sd4-11'(age_b)*11'd5); tile_c<=10'd7; pal_c<=4'd4;
                enable_c<=age_b<=7'd24;
            end
            K_ESHOT: begin
                x_c<=10'(11'sd72+11'(col_b)*11'sd24+enemy_dx); y_c<=10'(11'sd74+ripple+11'(age_b)*11'sd2);
                tile_c<=10'd8; pal_c<=4'd4; enable_c<=1;
            end
            K_ENEMY: begin
                x_c<=10'(11'sd68+11'(col_b)*11'sd24+enemy_dx); y_c<=10'(11'sd36+(row_b ? 11'sd24 : 11'sd0)+ripple);
                tile_c<=(row_b ? 10'd16 : 10'd24)+{7'd0,row[1]^col_b[0],2'd0}; pal_c<=row_b ? 4'd2 : 4'd3;
                big_c<=1; enable_c<=1;
            end
            K_STAR: begin
                x_c<=10'(11'(slot_b)*11'd80+11'd37);
                y_c<={2'd0,8'(8'(slot_b)*8'd67+8'(anim*3))}-10'd8; tile_c<=10'd6; enable_c<=1;
            end
            K_TITLE: begin
                x_c<=10'd108+{2'd0,slot_b<8 ? 5'(slot_b) : 5'(slot_b+5'd1),3'd0}; y_c<=10'd12;
                tile_c<=title_tile(slot_b[3:0]); pal_c<=4'd6; enable_c<=1;
            end
            K_WALL: begin
                x_c<=10'(11'(slot_b)*11'd14+11'd5); y_c<={2'd0,anim[7:0]}-10'd16;
                tile_c<=10'd16+{7'd0,row[1]^slot_b[0],2'd0}; pal_c<=4'd5; big_c<=1; enable_c<=wall_on;
            end
            default: ;
        endcase

        case(byte_c)
            3'd0: scene_oam_byte<=x_c[7:0];
            3'd1: scene_oam_byte<={6'd0,x_c[9:8]};
            3'd2: scene_oam_byte<=y_c[7:0];
            3'd3: scene_oam_byte<={6'd0,y_c[9:8]};
            3'd4: scene_oam_byte<=tile_c[7:0];
            3'd5: scene_oam_byte<={2'd0,pal_c,tile_c[9:8]};
            3'd6: scene_oam_byte<={6'd0,big_c,enable_c};
            default: scene_oam_byte<=0;
        endcase
    end
    wire [7:0] pal_out=SCENE ? scene_pal_byte : pal_byte;
    wire [7:0] pat_out=SCENE ? scene_pat_byte : pat_byte;
    wire [7:0] oam_out=SCENE ? scene_oam_byte : oam_byte;
    wire [7:0] map_out=SCENE ? scene_map_byte : map_byte;

    // One register access at a time, then SPACING idle cycles.
    reg busy, waiting, poll_read;
    reg [7:0] gap;
    reg [7:0] read_value;
    reg last_error;
    task automatic issue(input reg w,input reg [4:0] a,input reg [7:0] d);
        begin req_valid<=1; req_write<=w; req_addr<=a; req_wdata<=d; busy<=1; end
    endtask
    always @(posedge clk)
        music_tick<=!reset && !busy && gap==0 && step==S_MUSIC && !(last_error && req_write && req_addr==VRAM_WRITE);
    always @(posedge clk)
        if(reset) begin
            step<=S_INIT; count<=0; scroll_x<=0; scroll_y<=0; frame_div<=0; anim<=ANIM_START; rotate<=5'(8*ANIM_START%22); sprite_overflow<=0;
            req_valid<=0; req_write<=0; req_addr<=0; req_wdata<=0;
            busy<=0; waiting<=0; gap<=0; read_value<=0; last_error<=0; waves_twice<=0;
            configured<=0; frames<=0; map_bad<=0; data_bad<=0; map_readback<=0; map_written<=0;
        end else if(busy) begin
            if(req_valid && req_ready) begin req_valid<=0; waiting<=1; end
            if(waiting && rsp_valid) begin
                waiting<=0; busy<=0; gap<=8'(SPACING); read_value<=rsp_rdata; last_error<=rsp_error;
            end
        end else if(gap!=0) gap<=gap-1'b1;
        else begin
            // A refused VRAM write is repeated; the address did not advance.
            if(last_error && req_write && req_addr==VRAM_WRITE) issue(1,VRAM_WRITE,req_wdata);
            else case(step)
                S_INIT: if(req_addr==STATUS && !req_write && read_value[0]) step<=S_INC_L;
                    else issue(0,STATUS,8'h00);
                S_INC_L: begin issue(1,INC_L,8'd1); step<=S_INC_H; end
                S_INC_H: begin issue(1,INC_H,8'd0); step<=AUDIO ? S_WAVE_ADDR : S_PAL_ADDR; count<=0; end
                S_WAVE_ADDR: begin
                    case(count[1:0])
                        0: issue(1,ADDR_L,0);
                        1: issue(1,ADDR_M,8'h98);
                        default: issue(1,ADDR_H,0);
                    endcase
                    if(count==2) begin step<=S_WAVE; count<=0; end else count<=count+1'b1;
                end
                S_WAVE: begin
                    issue(1,VRAM_WRITE,wave_byte);
                    if(count==511) begin step<=waves_twice ? S_AUDIO_COMMIT : S_AUDIO_CFG; count<=0; end
                    else count<=count+1'b1;
                end
                S_AUDIO_CFG: begin
                    if(!count[0]) issue(1,AUDIO_INDEX,audio_now[15:8]);
                    else issue(1,AUDIO_DATA,audio_now[7:0]);
                    if(count==121) begin step<=S_AUDIO_COMMIT; count<=0; end else count<=count+1'b1;
                end
                S_AUDIO_COMMIT: begin issue(1,COMMAND,8'h04); step<=S_AUDIO_WAIT; end
                // music_tick fires now; the gap lets the list bytes settle.
                S_MUSIC: begin gap<=8'(SPACING); step<=S_MUSIC_WRITE; count<=0; end
                S_MUSIC_WRITE: begin
                    if(!count[0]) issue(1,AUDIO_INDEX,music_now[15:8]);
                    else issue(1,AUDIO_DATA,music_now[7:0]);
                    if(count==55) begin step<=S_AUDIO_COMMIT; count<=0; end else count<=count+1'b1;
                end
                S_AUDIO_WAIT: begin
                    // APPLY_BUSY clear: next frame step, the second wave
                    // load, or the video setup.
                    if(req_addr==AUDIO_DATA && !req_write && !read_value[0]) begin
                        count<=0;
                        if(configured) step<=S_SCROLL;
                        else if(waves_twice) step<=S_PAL_ADDR;
                        else begin waves_twice<=1; step<=S_WAVE_ADDR; end
                    end else if(req_addr!=AUDIO_INDEX && req_addr!=AUDIO_DATA) issue(1,AUDIO_INDEX,8'he1);
                    else issue(0,AUDIO_DATA,0);
                end
                S_PAL_ADDR: begin
                    case(count[1:0])
                        2'd0: issue(1,ADDR_L,8'h00);
                        2'd1: issue(1,ADDR_M,8'h94);
                        default: issue(1,ADDR_H,8'h00);
                    endcase
                    if(count[1:0]==2'd2) begin step<=S_PAL; count<=0; end else count<=count+1'b1;
                end
                S_PAL: begin
                    issue(1,VRAM_WRITE,pal_out);
                    if(count==13'd511) begin step<=S_PAT_ADDR; count<=0; end else count<=count+1'b1;
                end
                S_PAT_ADDR: begin
                    case(count[1:0])
                        2'd0: issue(1,ADDR_L,8'h00);
                        2'd1: issue(1,ADDR_M,8'h00);
                        default: issue(1,ADDR_H,8'h00);
                    endcase
                    if(count[1:0]==2'd2) begin step<=S_PAT; count<=0; end else count<=count+1'b1;
                end
                S_PAT: begin
                    issue(1,VRAM_WRITE,pat_out);
                    if(count==(SCENE ? 13'd2047 : 13'd511)) begin
                        step<=SPRITES || SCENE ? S_OAM_ADDR : S_MAP_ADDR; count<=0;
                    end else count<=count+1'b1;
                end
                S_OAM_ADDR: begin
                    case(count[1:0])
                        2'd0: issue(1,ADDR_L,8'h00);
                        2'd1: issue(1,ADDR_M,8'h90);
                        default: issue(1,ADDR_H,8'h00);
                    endcase
                    if(count[1:0]==2'd2) begin step<=S_OAM; count<=0; end else count<=count+1'b1;
                end
                S_OAM: begin
                    issue(1,VRAM_WRITE,oam_out);
                    if(count==13'd511) begin step<=S_MAP_ADDR; count<=0; end else count<=count+1'b1;
                end
                S_MAP_ADDR: begin
                    case(count[1:0])
                        2'd0: issue(1,ADDR_L,8'h00);
                        2'd1: issue(1,ADDR_M,8'h80);
                        default: issue(1,ADDR_H,8'h00);
                    endcase
                    if(count[1:0]==2'd2) begin step<=S_MAP; count<=0; end else count<=count+1'b1;
                end
                S_MAP: begin
                    issue(1,VRAM_WRITE,map_out);
                    // Capture the source bytes matching the read-back probes.
                    case(count)
                        13'd130: map_written[31:24]<=map_byte;
                        13'd131: map_written[23:16]<=map_byte;
                        13'd2058: map_written[15:8]<=map_byte;
                        13'd2059: map_written[7:0]<=map_byte;
                        default: ;
                    endcase
                    if(count==13'd4095) begin step<=S_EXT; count<=0; end else count<=count+1'b1;
                end
                S_EXT: begin
                    // EXT 03 BACKDROP=0, 04 RASTER=255 (off); the scene also
                    // sets 02 scroll Y=-anim for its first frame. RASTER then
                    // writes a 3-entry table: lines 100..129 fixed, 130..159
                    // shifted by 40 pixels, 160.. fixed.
                    case(count)
                        13'd0: issue(1,EXT_INDEX,8'h03);
                        13'd1: issue(1,EXT_DATA,8'h00);
                        13'd2: issue(1,EXT_INDEX,8'h04);
                        13'd3: issue(1,EXT_DATA,8'hff);
                        13'd4: issue(1,EXT_INDEX,8'h02);
                        13'd5: issue(1,EXT_DATA,8'(16'd0-anim));
                        default: issue(1,count[0] ? EXT_DATA : EXT_INDEX,
                            count[0] ? rs_pair(5'((count-13'd6)>>1))[7:0] : rs_pair(5'((count-13'd6)>>1))[15:8]);
                    endcase
                    if(count==(RASTER ? 13'd33 : SCENE ? 13'd5 : 13'd3)) begin step<=S_DISPLAY; count<=0; end else count<=count+1'b1;
                end
                S_DISPLAY: begin issue(1,DISPLAY_CTRL,SPRITES || SCENE ? 8'h07 : 8'h03); step<=S_COMMIT; end
                S_COMMIT: begin issue(1,COMMAND,8'h03); step<=S_WAIT; end
                S_WAIT: begin
                    // Poll STATUS until COMMIT_BUSY (b4) clears.
                    if(req_addr==STATUS && !req_write && !read_value[4]) begin
                        if(!configured) begin configured<=1; step<=SCENE ? S_ERR_READ : S_CHECK; count<=0; end
                        else begin frames<=frames+1'b1; step<=SCENE ? S_OVF_READ : AUDIO ? S_MUSIC : S_SCROLL; count<=0; end
                    end else issue(0,STATUS,8'h00);
                end
                S_CHECK: case(count[2:0])
                    // Entry count[5:3]: set the address, READ_REQUEST, poll STATUS
                    // until READ_READY (b2), read READ_RESULT, compare.
                    3'd0: begin issue(1,ADDR_L,check_now[15:8]); count<=count+1'b1; end
                    3'd1: begin issue(1,ADDR_M,check_now[23:16]); count<=count+1'b1; end
                    3'd2: begin issue(1,ADDR_H,8'h00); count<=count+1'b1; end
                    3'd3: begin issue(1,READ_REQUEST,8'h00); count<=count+1'b1; end
                    3'd4: begin issue(0,STATUS,8'h00); count<=count+1'b1; end
                    3'd5: if(read_value[2]) begin issue(0,READ_RESULT,8'h00); count<=count+1'b1; end
                        else issue(0,STATUS,8'h00);
                    default: begin
                        if(count[5:3]<3'd4) map_readback[31-8*count[4:3] -: 8]<=read_value;
                        if(read_value!=check_now[7:0]) begin
                            if(count[5:3]<3'd4) map_bad<=1; else data_bad<=1;
                        end
                        if(count[5:3]==3'd5) step<=S_ERR_READ;
                        else count<={count[12:6],count[5:3]+3'd1,3'd0};
                    end
                endcase
                S_ERR_READ: begin issue(0,ERROR_CODE,8'h00); step<=S_ERR_CLEAR; end
                S_ERR_CLEAR: begin issue(1,ERROR_CODE,read_value); step<=S_SCROLL; count<=0; end
                S_SCROLL: begin
                    // EXT 00 X low, 01 X bit 8, 02 Y; then (scene sprites,) COMMIT.
                    // The scene keeps X=0 and moves Y=-anim.
                    case(count[2:0])
                        3'd0: begin
                            scroll_x<=scroll_x+1'b1; frame_div<=frame_div+1'b1; anim<=anim+1'b1;
                            rotate<=rotate>=5'd14 ? rotate-5'd14 : rotate+5'd8;
                            if(frame_div==2'd3) scroll_y<=scroll_y+1'b1;
                            issue(1,EXT_INDEX,8'h00);
                        end
                        3'd1: issue(1,EXT_DATA,SCENE ? 8'd0 : scroll_x[7:0]);
                        3'd2: issue(1,EXT_INDEX,8'h01);
                        3'd3: issue(1,EXT_DATA,SCENE ? 8'd0 : {7'b0,scroll_x[8]});
                        3'd4: issue(1,EXT_INDEX,8'h02);
                        default: issue(1,EXT_DATA,SCENE ? 8'(16'd0-anim) : scroll_y);
                    endcase
                    if(count[2:0]==3'd5) begin step<=SCENE ? S_SCENE_ADDR : S_COMMIT; count<=0; end
                    else count<=count+1'b1;
                end
                S_SCENE_ADDR: begin
                    case(count[1:0])
                        2'd0: issue(1,ADDR_L,8'h00);
                        2'd1: issue(1,ADDR_M,8'h90);
                        default: issue(1,ADDR_H,8'h00);
                    endcase
                    if(count[1:0]==2'd2) begin step<=S_SCENE_OAM; count<=0; end else count<=count+1'b1;
                end
                S_SCENE_OAM: begin
                    issue(1,VRAM_WRITE,scene_oam_byte);
                    if(count==13'd511) begin step<=S_SCENE_PAL; count<=0; end else count<=count+1'b1;
                end
                S_SCENE_PAL: begin
                    // count 0..2 address of word 06, 4..7 words 06/07;
                    // 8..10 address of word 61, 12..13 word 61.
                    case(count[2:0])
                        3'd0: issue(1,ADDR_L,count[3] ? 8'hc2 : 8'h0c);
                        3'd1: issue(1,ADDR_M,8'h94);
                        3'd2: issue(1,ADDR_H,8'h00);
                        default: issue(1,VRAM_WRITE,scene_pal_byte);
                    endcase
                    if(count==13'd2 || count==13'd10) count<=count+13'd2;
                    else if(count==13'd13) begin step<=S_COMMIT; count<=0; end
                    else count<=count+1'b1;
                end
                // Sample and clear SPR_OVERFLOW once per update.
                S_OVF_READ: begin issue(0,IRQ_STATUS,8'h00); step<=S_OVF_CLEAR; end
                S_OVF_CLEAR: begin
                    sprite_overflow<=read_value[5]; issue(1,IRQ_STATUS,read_value&8'h20);
                    step<=AUDIO ? S_MUSIC : S_SCROLL; count<=0;
                end
                default: ;
            endcase
        end
endmodule
